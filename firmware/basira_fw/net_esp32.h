// Wi-Fi access point + HTTP server (serves the app) + WebSocket (/ws), using ESP-IDF's built-in esp_http_server.
// The server runs in its own task: received lines are queued and handled in loop(), so the device and protocol
// are only ever touched from one task.
#pragma once
#ifdef ARDUINO
#include <Arduino.h>
#include <WiFi.h>
#include <esp_http_server.h>
#include <lwip/sockets.h>
#include "config.h"
#include "app_bundle.h"   // generated by tools/build_app_bundle.py: APP_HTML_GZ, APP_HTML_GZ_LEN

namespace basira {
namespace net {

static const int MAX_CLIENTS = 4;
static const size_t MAX_LINE = 512;
struct Line { char s[MAX_LINE]; };

static httpd_handle_t server = nullptr;
static QueueHandle_t rxq = nullptr;
static volatile int clients[MAX_CLIENTS] = {-1, -1, -1, -1};
static volatile bool closedFlag = false, openedFlag = false;

static void addClient(int fd) {
  for (int i = 0; i < MAX_CLIENTS; i++) if (clients[i] == fd) return;
  for (int i = 0; i < MAX_CLIENTS; i++) if (clients[i] < 0) { clients[i] = fd; openedFlag = true; return; }
}

static void onClose(httpd_handle_t, int fd) {
  for (int i = 0; i < MAX_CLIENTS; i++) if (clients[i] == fd) { clients[i] = -1; closedFlag = true; }
  close(fd);
}

static esp_err_t handleRoot(httpd_req_t* req) {
  httpd_resp_set_type(req, "text/html");
  httpd_resp_set_hdr(req, "Content-Encoding", "gzip");
  return httpd_resp_send(req, (const char*)APP_HTML_GZ, APP_HTML_GZ_LEN);
}

static esp_err_t handleWs(httpd_req_t* req) {
  if (req->method == HTTP_GET) { addClient(httpd_req_to_sockfd(req)); return ESP_OK; }   // handshake done
  httpd_ws_frame_t f = {};
  f.type = HTTPD_WS_TYPE_TEXT;
  esp_err_t e = httpd_ws_recv_frame(req, &f, 0);            // length only
  if (e != ESP_OK) return e;
  if (f.type != HTTPD_WS_TYPE_TEXT || f.len == 0 || f.len >= MAX_LINE) return ESP_FAIL;   // protocol violation: close
  Line ln;
  f.payload = (uint8_t*)ln.s;
  e = httpd_ws_recv_frame(req, &f, f.len);
  if (e != ESP_OK) return e;
  ln.s[f.len] = 0;
  addClient(httpd_req_to_sockfd(req));
  xQueueSend(rxq, &ln, 0);                                   // full queue: drop (the app retries / pings)
  return ESP_OK;
}

inline void begin() {
  rxq = xQueueCreate(8, sizeof(Line));
  WiFi.mode(WIFI_AP);
  WiFi.softAP(WIFI_SSID, WIFI_PASS);
  httpd_config_t cfg = HTTPD_DEFAULT_CONFIG();
  cfg.server_port = 80;
  cfg.close_fn = onClose;
  cfg.max_open_sockets = 6;
  if (httpd_start(&server, &cfg) != ESP_OK) { server = nullptr; return; }
  httpd_uri_t root = {};
  root.uri = "/"; root.method = HTTP_GET; root.handler = handleRoot;
  httpd_register_uri_handler(server, &root);
  httpd_uri_t ws = {};
  ws.uri = "/ws"; ws.method = HTTP_GET; ws.handler = handleWs; ws.is_websocket = true;
  httpd_register_uri_handler(server, &ws);
}

// Next received line, if any (call from loop()).
inline bool poll(Line& out) { return rxq && xQueueReceive(rxq, &out, 0) == pdTRUE; }
inline bool takeClosed() { bool c = closedFlag; closedFlag = false; return c; }
inline bool takeOpened() { bool o = openedFlag; openedFlag = false; return o; }

inline void broadcast(const char* json) {
  if (!server) return;
  httpd_ws_frame_t f = {};
  f.type = HTTPD_WS_TYPE_TEXT;
  f.payload = (uint8_t*)json;
  f.len = strlen(json);
  for (int i = 0; i < MAX_CLIENTS; i++) {
    int fd = clients[i];
    if (fd < 0) continue;
    if (httpd_ws_get_fd_info(server, fd) != HTTPD_WS_CLIENT_WEBSOCKET) { clients[i] = -1; closedFlag = true; continue; }
    httpd_ws_send_frame_async(server, fd, &f);
  }
}

}  // namespace net
}  // namespace basira
#endif
